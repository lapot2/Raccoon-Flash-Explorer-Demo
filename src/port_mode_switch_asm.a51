$NOMOD51

NAME	PORT_MODE_SWITCH_ASM

P0M1	DATA	093H
P1M0	DATA	092H
P2M0	DATA	096H
P1M1	DATA	091H
P0	DATA	080H
P3M0	DATA	0B2H
P2M1	DATA	095H
P1	DATA	090H
P4M0	DATA	0B4H
P3M1	DATA	0B1H
P2	DATA	0A0H
P5M0	DATA	0CAH
P4M1	DATA	0B3H
P3	DATA	0B0H
WKTCH	DATA	0ABH
AC	BIT	0D0H.6
P6M0	DATA	0CCH
P5M1	DATA	0C9H
P4	DATA	0C0H
P7M0	DATA	0E2H
P6M1	DATA	0CBH
P5	DATA	0C8H
P6	DATA	0E8H
P7M1	DATA	0E1H
EA	BIT	0A8H.7
P7	DATA	0F8H
WKTCL	DATA	0AAH
SPCTL	DATA	0CEH
P_SW1	DATA	0A2H
ADC_VAL	DATA	0BDH
P_SW2	DATA	0BAH
DPH1	DATA	0E5H
EADC	BIT	0A8H.5
IE	DATA	0A8H
IAP_CMD	DATA	0C5H
DPL1	DATA	0E4H
ADC_RES	DATA	0BDH
IP2H	DATA	0B6H
IP3H	DATA	0EEH
TA	DATA	0AEH
INTCLKO	DATA	08FH
ES	BIT	0A8H.4
PADC	BIT	0B8H.5
IP	DATA	0B8H
ADCCFG	DATA	0DEH
RI	BIT	098H.0
CY	BIT	0D0H.7
TI	BIT	098H.1
IAP_ADDRH	DATA	0C3H
PS	BIT	0B8H.4
SP	DATA	081H
IAP_ADDRL	DATA	0C4H
OV	BIT	0D0H.2
PPCA	BIT	0B8H.7
LIRTRIM	DATA	09EH
CMPCR1	DATA	0E6H
CMPCR2	DATA	0E7H
ELVD	BIT	0A8H.6
P00	BIT	080H.0
ADC_CONTR	DATA	0BCH
SBUF	DATA	099H
P10	BIT	090H.0
PCON	DATA	087H
P01	BIT	080H.1
P20	BIT	0A0H.0
P11	BIT	090H.1
P02	BIT	080H.2
IAP_TPS	DATA	0F5H
P30	BIT	0B0H.0
P21	BIT	0A0H.1
P12	BIT	090H.2
P03	BIT	080H.3
P40	BIT	0C0H.0
P31	BIT	0B0H.1
P22	BIT	0A0H.2
SCON	DATA	098H
P13	BIT	090H.3
P04	BIT	080H.4
P50	BIT	0C8H.0
P41	BIT	0C0H.1
P32	BIT	0B0H.2
P23	BIT	0A0H.3
P14	BIT	090H.4
TMOD	DATA	089H
TCON	DATA	088H
P05	BIT	080H.5
P60	BIT	0E8H.0
P51	BIT	0C8H.1
P42	BIT	0C0H.2
P33	BIT	0B0H.3
P24	BIT	0A0H.4
P15	BIT	090H.5
P06	BIT	080H.6
P70	BIT	0F8H.0
P61	BIT	0E8H.1
P52	BIT	0C8H.2
P43	BIT	0C0H.3
PLVD	BIT	0B8H.6
P34	BIT	0B0H.4
P25	BIT	0A0H.5
P16	BIT	090H.6
P07	BIT	080H.7
P71	BIT	0F8H.1
P62	BIT	0E8H.2
P53	BIT	0C8H.3
P44	BIT	0C0H.4
P35	BIT	0B0H.5
P26	BIT	0A0H.6
P17	BIT	090H.7
P72	BIT	0F8H.2
P63	BIT	0E8H.3
P54	BIT	0C8H.4
P45	BIT	0C0H.5
P36	BIT	0B0H.6
P27	BIT	0A0H.7
P73	BIT	0F8H.3
P64	BIT	0E8H.4
P55	BIT	0C8H.5
P46	BIT	0C0H.6
P37	BIT	0B0H.7
P74	BIT	0F8H.4
P65	BIT	0E8H.5
P56	BIT	0C8H.6
P47	BIT	0C0H.7
P75	BIT	0F8H.5
P66	BIT	0E8H.6
P57	BIT	0C8H.7
P76	BIT	0F8H.6
P67	BIT	0E8H.7
P77	BIT	0F8H.7
IE0	BIT	088H.1
IE1	BIT	088H.3
IE2	DATA	0AFH
B	DATA	0F0H
AUXR	DATA	08EH
USBADR	DATA	0FCH
IAP_CONTR	DATA	0C7H
USBDAT	DATA	0ECH
USBCLK	DATA	0DCH
ACC	DATA	0E0H
ET0	BIT	0A8H.1
ET1	BIT	0A8H.3
TF0	BIT	088H.5
RSTCFG	DATA	0FFH
IP2	DATA	0B5H
TF1	BIT	088H.7
USBCON	DATA	0F4H
IP3	DATA	0DFH
RB8	BIT	098H.2
TH0	DATA	08CH
P0M	DATA	093H
EX0	BIT	0A8H.0
TH1	DATA	08DH
IT0	BIT	088H.0
P1M	DATA	091H
T2H	DATA	0D6H
EX1	BIT	0A8H.2
TB8	BIT	098H.3
IT1	BIT	088H.2
P2M	DATA	095H
T3H	DATA	0D4H
P	BIT	0D0H.0
P3M	DATA	0B1H
T4H	DATA	0D2H
SM0	BIT	098H.7
TL0	DATA	08AH
P4M	DATA	0B3H
SM1	BIT	098H.6
TL1	DATA	08BH
P5M	DATA	0C9H
T2L	DATA	0D7H
SM2	BIT	098H.5
P6M	DATA	0CBH
T3L	DATA	0D5H
P7M	DATA	0E1H
T4L	DATA	0D3H
PT0	BIT	0B8H.1
RS0	BIT	0D0H.3
PT1	BIT	0B8H.3
RS1	BIT	0D0H.4
IAP_DATA	DATA	0C2H
TR0	BIT	088H.4
TR1	BIT	088H.6
WDT_CONTR	DATA	0C1H
PX0	BIT	0B8H.0
PX1	BIT	0B8H.2
IRTRIM	DATA	09FH
DPH	DATA	083H
T4T3M	DATA	0D1H
ADC_RESL	DATA	0BEH
DPL	DATA	082H
SPSTAT	DATA	0CDH
IPH	DATA	0B7H
S2BUF	DATA	09BH
S3BUF	DATA	0ADH
REN	BIT	098H.4
S4BUF	DATA	085H
S2CON	DATA	09AH
DPS	DATA	0E3H
S3CON	DATA	0ACH
S4CON	DATA	084H
DPTR0	DATA	082H
AUXINTIF	DATA	0EFH
DPTR1	DATA	0E4H
SADEN	DATA	0B9H
SADDR	DATA	0A9H
IAP_TRIG	DATA	0C6H
F0	BIT	0D0H.5
IRCBAND	DATA	09DH
F1	BIT	0D0H.1
PSW	DATA	0D0H
SPDAT	DATA	0CFH
P0M0	DATA	094H

DPL0	DATA 082H
DPH0	DATA 083H	
;DPL1	DATA 0E4H
;DPH1	DATA 0E5H
	
DPTR1_AUTODEC	EQU		0x80
DPTR0_AUTODEC	EQU		0x40
DPTR_AUTOSEL	EQU		0x20
DPTR1_AUTOEN	EQU		0x10
DPTR0_AUTOEN	EQU		0x08
DPTR1_SEL		EQU		0x01
DPTR0_SEL		EQU		0x00
	
;?PR?_port_cfg?PORT_MODE_SWITCH           SEGMENT CODE 
;?XD?_port_cfg?PORT_MODE_SWITCH_ASM           SEGMENT XDATA OVERLAYABLE 
?PR?_port_cfg_get?PORT_MODE_SWITCH_ASM       SEGMENT CODE 
?PR?_port_cfg_submit?PORT_MODE_SWITCH_ASM    SEGMENT CODE 
?PR?_pin_mode_set?PORT_MODE_SWITCH       SEGMENT CODE 
;?DT?_port_cfg?PORT_MODE_SWITCH_ASM           SEGMENT DATA OVERLAYABLE 
	;EXTRN	CODE (?C?ISTPTR)
	;EXTRN	CODE (?C?ISTOPTR)
	;EXTRN	CODE (?C?ILDPTR)
	;EXTRN	CODE (?C?ILDOPTR)
	PUBLIC	_pin_mode_set
	PUBLIC	_port_cfg_submit
	PUBLIC	_port_cfg_get
	;PUBLIC	_port_cfg

	;RSEG  ?XD?_port_cfg?PORT_MODE_SWITCH_ASM
;?_port_cfg?BYTE:
      ;pmbuf?042:   DS   16

	;RSEG  ?DT?_port_cfg?PORT_MODE_SWITCH_ASM
          ;i?044:   DS   1

	;RSEG  ?DT?_port_cfg?PORT_MODE_SWITCH_ASM
      ;state?045:   DS   1

;extern void port_cfg_get(PORT_MODE xdata * portmode);
RSEG  ?PR?_port_cfg_get?PORT_MODE_SWITCH_ASM
_port_cfg_get:
	USING 0
	PUSH DPS
	MOV DPS, #(DPTR1_AUTOEN | DPTR0_AUTOEN)
	MOV DPH, R6
	MOV DPL, R7
	;
	MOV A, P0M0
	MOVX @DPTR, A
	MOV A, P0M1
	MOVX @DPTR, A
	MOV A, P1M0
	MOVX @DPTR, A
	MOV A, P1M1
	MOVX @DPTR, A
	MOV A, P2M0
	MOVX @DPTR, A
	MOV A, P2M1
	MOVX @DPTR, A
	MOV A, P3M0
	MOVX @DPTR, A
	MOV A, P3M1
	MOVX @DPTR, A
	MOV A, P4M0
	MOVX @DPTR, A
	MOV A, P4M1
	MOVX @DPTR, A
	MOV A, P5M0
	MOVX @DPTR, A
	MOV A, P5M1
	MOVX @DPTR, A
	MOV A, P6M0
	MOVX @DPTR, A
	MOV A, P6M1
	MOVX @DPTR, A
	MOV A, P7M0
	MOVX @DPTR, A
	MOV A, P7M1
	MOVX @DPTR, A
	;
	
	POP DPS
	RET
	
;extern void port_cfg_submit(PORT_MODE xdata * portmode);
RSEG  ?PR?_port_cfg_submit?PORT_MODE_SWITCH_ASM
_port_cfg_submit:
	USING 0
	PUSH DPS
	MOV DPS, #(DPTR1_AUTOEN | DPTR0_AUTOEN)
	MOV DPH, R6
	MOV DPL, R7
	;
	MOVX A, @DPTR
	MOV P0M0, A
	MOVX A, @DPTR
	MOV P0M1, A
	MOVX A, @DPTR
	MOV P1M0, A
	MOVX A, @DPTR
	MOV P1M1, A
	MOVX A, @DPTR
	MOV P2M0, A
	MOVX A, @DPTR
	MOV P2M1, A
	MOVX A, @DPTR
	MOV P3M0, A
	MOVX A, @DPTR
	MOV P3M1, A
	MOVX A, @DPTR
	MOV P4M0, A
	MOVX A, @DPTR
	MOV P4M1, A
	MOVX A, @DPTR
	MOV P5M0, A
	MOVX A, @DPTR
	MOV P5M1, A
	MOVX A, @DPTR
	MOV P6M0, A
	MOVX A, @DPTR
	MOV P6M1, A
	MOVX A, @DPTR
	MOV P7M0, A
	MOVX A, @DPTR
	MOV P7M1, A
	;
	
	POP DPS
	RET
	
;uint16_t pin_mode_set(char pin(R7), uint16_t xdata pinmode(R4-R5), uint16_t xdata port(R2-R3))
	RSEG	?PR?_pin_mode_set?PORT_MODE_SWITCH
_pin_mode_set:
	USING	0
	PUSH DPS
	MOV DPS, #(DPTR1_AUTOEN | DPTR0_AUTOEN)
	MOV AR0, R2
	MOV AR1, R3
	MOV A, R7
	ANL A, #0F0H
	SWAP A
	MOV B, #02H
	MUL AB
	CLR C
	ADDC A, R3
	MOV DPL, A
	MOV DPL1, A
	JNC inc_high_not_need
	INC R2
	inc_high_not_need:
	MOV DPH, R2
	MOV DPH1, R2
	;
	MOVX A, @DPTR
	MOV R2, A
	MOVX A, @DPTR
	MOV R3, A
	;
	ANL AR7, #0FH
	ANL AR4, #01H
	ANL AR5, #01H
	;
	;MOV R7, #02H
	;MOV R6, #00H
	;MOV R0, #04H
	;
	MOV R6, #01H
	;
	MOV A, R7
	JZ skip_repeat
	repeat:
	MOV A, R4
	RL A
	MOV R4, A
	MOV A, R5
	RL A
	MOV R5, A
	MOV A, R6
	RL A
	MOV R6, A
	DJNZ R7, repeat
	skip_repeat:
	;
	MOV A, R6
	
	;
	; CLEAR MASK AND
	ORL A, R4
	ORL A, R5
	CPL A
	ANL AR2, A
	ANL AR3, A
	;
	; SET MASK OR
	MOV A, R4
	ORL AR2, A
	MOV A, R5
	ORL AR3, A
	;
	;MOV R7, AR3
	;MOV R6, AR2
	;
	INC DPS
	MOV A, R2
	MOVX @DPTR, A
	MOV A, R3
	MOVX @DPTR, A
	MOV R7, AR1
	MOV R6, AR0
	
	POP DPS
	RET
		  
	END